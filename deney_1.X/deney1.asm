; PIC16F877A Configuration Bit Settings

; ASM source line config statements

#include "p16F877A.inc"

; CONFIG
; __config 0xFFF9
 __CONFIG _FOSC_XT & _WDTE_OFF & _PWRTE_OFF & _BOREN_ON & _LVP_ON & _CPD_OFF & _WRT_OFF & _CP_OFF
 
 
SAYAC1 EQU 0X20
SAYAC2 EQU 0X21
SAYAC3 EQU 0X22 
ORG 0
 CLRF PORTD
BSF STATUS,5
CLRF TRISD
BCF STATUS,5  
TEKRAR
MOVLW h'00'
MOVWF PORTD

CALL GECIKME
MOVLW h'C6'
MOVWF PORTD
CALL GECIKME
GOTO TEKRAR
GECIKME 
MOVLW D'250' 
MOVWF SAYAC1
DONGU1
MOVLW D'250' 
MOVWF SAYAC2
DONGU2
MOVLW D'4'
MOVWF SAYAC3
DONGU3
DECFSZ SAYAC3,F
GOTO DONGU3
DECFSZ SAYAC2, F
GOTO DONGU2
DECFSZ SAYAC1, F
GOTO DONGU1
RETURN
END
